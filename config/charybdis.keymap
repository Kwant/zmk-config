#define CONFIG_WIRELESS
#define ZMK_BASE_LAYER(name, LT, RT, LM, RM, LB, RB, LH, RH)            
#include <dt-bindings/zmk/outputs.h>
#include <input/processors.dtsi>
#include <dt-bindings/zmk/input_transform.h>       

    ZMK_LAYER(                                                                 \
        name,                                                                  \
                 LT RT                                                         \
                 LM RM                                                         \
                 LB RB                                                         \
       SMART_NUM LH RH MAGIC_SHIFT                                             \
    )

#include "zmk-helpers/key-labels/36.h"
#include "base.keymap"
